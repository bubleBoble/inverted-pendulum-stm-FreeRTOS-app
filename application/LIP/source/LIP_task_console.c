/*
 * This file contains task that implements freeRTOS cli.
 * With prompt and backspace support.
 * Awesome tutorial on how to make freeRTOS console better:
 *     https://www.edwinfairchild.com/p/making-freertos-cli-more-cli-ish_14.html
 */
#include "LIP_tasks_common.h"

/*
 * App globals defined in LIP_tasks_common.c
 */
extern uint8_t             rx_char;
extern enum lip_app_states app_current_state;

/*
 * Prompt
 */
char msg[100];
typedef struct {
        char *prompt_str;
        char *preprompt_str;
        uint8_t alt_prompt_active;
        uint8_t pausePrompt;
} prompt_t;

prompt_t prompt;
char prompt_str[] = ">>> ";
/* Each state has its own preprompt */
char no_prePrompt[]     = "[       ?       ]";
char uninit_state_pp[]  = "[ uninitialzied ]";
char default_state_pp[] = "[    default    ]";
char DPC_state_pp[]     = "[      dpc      ]";
char UPC_state_pp[]     = "[      upc      ]";
char swingup_state_pp[] = "[    swingup    ]";
char test_state_pp[]    = "[     tests     ]";

/* 
 * Function to print full prompt with preprompt string which indicates current
 * app state
 */
void show_prompt(void)
{
        switch (app_current_state) {
        case UNINITIALIZED:
                prompt.preprompt_str = uninit_state_pp;
                break;
        case DEFAULT:
                prompt.preprompt_str = default_state_pp;
                break;
        case DPC:
                prompt.preprompt_str = DPC_state_pp;
                break;
        case UPC:
                prompt.preprompt_str = UPC_state_pp;
                break;
        case SWINGUP:
                prompt.preprompt_str = swingup_state_pp;
                break;
        case TEST:
                prompt.preprompt_str = test_state_pp;
                break;
        default:
                prompt.preprompt_str = no_prePrompt;
                break;
        }

        sprintf(msg, "\r\n%s %s", prompt.preprompt_str, prompt.prompt_str);
        com_send(msg, strlen(msg));
        // printf( "\r\n%s %s", prompt.preprompt_str, prompt.prompt_str );
        // fflush( stdout );
}

/* 
 * CLI escape sequences to perform backspace operation in console. backspace,
 * print blank and backspace again
 */
// uint8_t backspace[] = "\x08 \x08";
uint8_t bs_delete_action[] = "\b \b";

void console_task(void *params)
{
        /* Keeps track of the number of input characters */
        int8_t     inp_idx = 0;
        BaseType_t more_data;

        /* 
         * The input and output buffers are declared static to keep
         * them off the stack
         */
        static int8_t output_str[MAX_OUTPUT_LENGTH];
        static int8_t input_string[MAX_INPUT_LENGTH];

        TickType_t last_wake_time = xTaskGetTickCount();

        register_CLI_commands();

        vTaskDelay(1000);

        /* Clear screen before cli start */
        // com_send("\e[1;1H\e[2J", 10);
        com_send("\033[1;1H\033[2J", 10);
        sprintf(msg, "\r\n******************************************\r\n");
        com_send(msg, strlen(msg));
        sprintf(msg, "*********** FreeRTOS based CLI ***********\r\n");
        com_send(msg, strlen(msg));
        sprintf(msg, "******************************************\r\n");
        com_send(msg, strlen(msg));
        // printf( "\r\n******************************************\r\n" );
        // printf(     "*********** FreeRTOS based CLI ***********\r\n" );
        // printf(     "******************************************\r\n" );

        prompt.prompt_str = prompt_str;
        show_prompt();

        for (;;) {
                if (rx_char != 0x00) /* better to use notification here */
                {
                        if (rx_char == '\n' || rx_char == '\r') {
                                com_send("\r\n", 2);
                                // printf("\r\n");
                                // fflush(stdout);
                                /* 
                                 * The command interpreter is called repeatedly
                                 * until it returns pdFALSE.  See the
                                 * "Implementing a command" documentation for an
                                 * exaplanation of why this is
                                 */
                                do {
                                        /* 
                                         * Send the command string to the
                                         * command interpreter. Any output
                                         * generated by the command interpreter
                                         * will be placed in the output_str
                                         * buffer
                                         */
                                        more_data = FreeRTOS_CLIProcessCommand(
                                                input_string,
                                                output_str,
                                                MAX_OUTPUT_LENGTH);

                                        int limit;
                                        if (more_data == pdTRUE)
                                                limit = MAX_OUTPUT_LENGTH;
                                        else
                                                limit = strlen((
                                                        const char *)output_str);

                                        for (int i = 0; i < limit; i++) {
                                                sprintf(msg, "%c",
                                                        *(output_str + i));
                                                com_send(msg, strlen(msg));

                                                // printf("%c", 
                                                //        *(output_str + i) );
                                                // fflush(stdout);
                                        }

                                } while (more_data != pdFALSE);

                                inp_idx = 0;
                                memset(input_string, 0x00, MAX_INPUT_LENGTH);
                                memset(output_str, 0x00, MAX_INPUT_LENGTH);
                                show_prompt();
                        } else {
                                /* 
                                 * The if() clause performs the processing after
                                 * a newline character is received.  This else
                                 * clause performs the processing if any other
                                 * character is received
                                 */
                                if (rx_char == '\b') {
                                        /*
                                         * Backspace was pressed. Erase the
                                         * last character in the input buffer
                                         * - if there are any
                                         */
                                        if (inp_idx > 0) {
                                                inp_idx--;
                                                /*
                                                 * The deleted character is set
                                                 * to zero in case the user
                                                 * won't type anything else
                                                 * after backspace
                                                 */
                                                memset(&input_string[inp_idx],
                                                       0x00, 1);

                                                sprintf(msg, "%s",
                                                        (const uint8_t *)
                                                                bs_delete_action);
                                                com_send(msg, strlen(msg));
                                        }
                                        // fflush(stdout);
                                } else {
                                        /* 
                                         * A character was entered.  It was not
                                         * a new line, backspace or carriage
                                         * return, so it is accepted as part of
                                         * the input and placed into the input
                                         * buffer. When a n is entered the
                                         * complete string will be passed to the
                                         * command interpreter
                                         */
                                        if (inp_idx < MAX_INPUT_LENGTH) {
                                                input_string[inp_idx] = rx_char;
                                                inp_idx++;

                                                sprintf(msg, "%c", rx_char);
                                                com_send(msg, strlen(msg));
                                        }
                                }
                        }
                        rx_char = 0x00;
                        // fflush( stdout );
                } /* if (rx_char != 0x00) */
                vTaskDelayUntil(&last_wake_time, dt_console);
        } /* for( ;; ) */
} /* console_task */
